## config/west.yml
```yaml
manifest:
  remotes:
    - name: zmkfirmware
      url-base: https://github.com/zmkfirmware
  projects:
    # ZMK v0.4 は未リリースのため、Zephyr 4.1 を含む main を SHA で pin する。
    # v0.4.0 がタグされたら revision: v0.4.0 に差し替えるだけでよい
    # （Zephyr は v4.1.0+zmk-fixes のまま変わらないので再移行は不要）。
    - name: zmk
      remote: zmkfirmware
      revision: main
      import: app/west.yml
  self:
    path: config
```
